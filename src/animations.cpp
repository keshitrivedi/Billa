#include <Arduino.h>
#include <Wire.h>
#include <Adafruit_GFX.h>
#include <Adafruit_SH110X.h>

#include <animations.h>

unsigned long lastFrameTime = 0;
int frameIndex = 0;

static const unsigned char PROGMEM open_eyes_bits[] = {0x00,0x00,0x00,0x00,0x00,0x00,0x00,0x00,0x00,0x00,0x00,0x00,0x00,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0x00,0x00};
static const unsigned char PROGMEM closed_eyes_bits[] = {0x00,0x00,0x00,0x00,0x00,0x00,0x00,0x00,0x00,0x00,0x00,0x00,0x00,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0x00,0x00};
static const unsigned char PROGMEM closed_eyes_left_bits[] = {0x00,0x00,0x00,0x00,0x00,0x00,0x00,0x00,0x00,0x00,0x00,0x00,0x00,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0x00,0x00};
static const unsigned char PROGMEM closed_eyes_right_bits[] = {0x00,0x00,0x00,0x00,0x00,0x00,0x00,0x00,0x00,0x00,0x00,0x00,0x00,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0x00,0x00};
static const unsigned char PROGMEM uwu_1_bits[] = {0x00,0x00,0x00,0x00,0x00,0x00,0x00,0x00,0x00,0x00,0x00,0x00,0x00,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0x00,0x00};
static const unsigned char PROGMEM uwu_2_bits[] = {0x00,0x00,0x00,0x00,0x00,0x00,0x00,0x00,0x00,0x00,0x00,0x00,0x00,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0x00,0x00};
static const unsigned char PROGMEM clueless_uwu_1_bits[] = {0x00,0x00,0x00,0x00,0x00,0x00,0x00,0x00,0x00,0x00,0x00,0x00,0x00,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0x00,0x00};
static const unsigned char PROGMEM clueless_uwu_2_bits[] = {0x00,0x00,0x00,0x00,0x00,0x00,0x00,0x00,0x00,0x00,0x00,0x00,0x00,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0x00,0x00};

const unsigned char* blink_frames[2] = {
  open_eyes_bits,
  closed_eyes_bits
};

const unsigned char* search_frames[5] = {
  closed_eyes_left_bits,
  closed_eyes_bits,
  open_eyes_bits,
  closed_eyes_bits,
  closed_eyes_right_bits
};

const unsigned char* uwu_frames[2] = {
  uwu_1_bits,
  uwu_2_bits
};

const unsigned char* uwu_clueless_frames[2] = {
  clueless_uwu_1_bits,
  clueless_uwu_2_bits
};

void toggle_frames(const unsigned char* frames[2], int dly, Adafruit_SH1106G &display) {
  for (int i = 0; i < 2; i++) {
    display.clearDisplay();
    display.drawBitmap(0, 0, frames[i], 128, 64, 1);
    display.display();
    delay(dly);
  }
}

void toggle_frames_millis(const unsigned char* frames[], int dly, int frameNum, Adafruit_SH1106G &display) {
  unsigned long now = millis();

  if (now - lastFrameTime > dly) {
    lastFrameTime = now;

    display.clearDisplay();
    display.drawBitmap(0, 0, frames[frameIndex], 128, 64, 1);
    display.display();

    frameIndex = (frameIndex + 1) % frameNum;
  }
}

// Make sure the number for frames is atleast three ^-^
void revolve_frames(int sze, const unsigned char* frames[], int dly, Adafruit_SH1106G &display) {
  for (int i = 0; i < sze; i++) {
    display.clearDisplay();
    display.drawBitmap(0, 0, frames[i], 128, 64, 1);
    display.display();
    delay(700);
  }

  for (int i = sze - 2; i > 0; i--) {
    display.clearDisplay();
    display.drawBitmap(0, 0, frames[i], 128, 64, 1);
    display.display();
    delay(700);
  }
}

void searchAround(Adafruit_SH1106G &display) {
  for (int i = 0; i < 5; i++) {
    display.clearDisplay();
    display.drawBitmap(0, 0, search_frames[i], 128, 64, 1);
    display.display();
    delay(700);
  }

  for (int i = 3; i > 0; i--) {
    display.clearDisplay();
    display.drawBitmap(0, 0, search_frames[i], 128, 64, 1);
    display.display();
    delay(700);
  }
}